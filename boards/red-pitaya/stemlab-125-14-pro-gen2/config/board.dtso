#define RED_PITAYA_MODEL "STEMlab 125-14 PRO Gen 2"
#define RED_PITAYA_COMPATIBLE "redpitaya,red-pitaya-pro-gen2"
#define RED_PITAYA_MEMORY_SIZE 0x20000000
#include "boards/red-pitaya/stemlab-125-14-gen2/config/board-common.dtsi"
