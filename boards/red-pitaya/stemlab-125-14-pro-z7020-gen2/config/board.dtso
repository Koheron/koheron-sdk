#define RED_PITAYA_MODEL "STEMlab 125-14 PRO Z7020 Gen 2"
#define RED_PITAYA_COMPATIBLE "redpitaya,red-pitaya-pro-z7020-gen2"
#define RED_PITAYA_MEMORY_SIZE 0x40000000
#include "boards/red-pitaya/stemlab-125-14-gen2/config/board-common.dtsi"
