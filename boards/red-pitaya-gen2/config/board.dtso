#define RED_PITAYA_MODEL "Red Pitaya STEMlab 125-14 Gen2"
#define RED_PITAYA_COMPATIBLE "redpitaya,red-pitaya-gen2"
#define RED_PITAYA_MEMORY_SIZE 0x20000000
#include "boards/red-pitaya-gen2/config/board-common.dtsi"
