/*
 *  Copyright (C) 2011 - 2014 Xilinx
 *  Copyright (C) 2012 National Instruments Corp.
 *
 * This software is licensed under the terms of the GNU General Public
 * License version 2, as published by the Free Software Foundation, and
 * may be copied, distributed, and modified under those terms.
 *
 * This program is distributed in the hope that it will be useful,
 * but WITHOUT ANY WARRANTY; without even the implied warranty of
 * MERCHANTABILITY or FITNESS FOR A PARTICULAR PURPOSE.  See the
 * GNU General Public License for more details.
 */
/dts-v1/;
/include/ "zynq-7000.dtsi"
/include/ "zynq-enclustra-zx-common.dtsi"
/include/ "zynq-enclustra-qspi64-parts.dtsi"

/ {
	model = "Enclustra Mercury ZX1 SOM";

	memory {
		device_type = "memory";
		reg = <0x0 0x20000000>;
	};
};

&uart0 {
	status = "okay";
};

&isl12022 {
	status = "okay";
};
